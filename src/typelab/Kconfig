## src/typelab/Kconfig
```kconfig
config ZEPHLET_TYPELAB
    bool "typelab Zephlet Module"
    select NANOPB
    select ZBUS
    select ZBUS_ASYNC_LISTENER
    help
      Enable this option to include the typelab Zephlet Module in the build.
      typelab Zephlet Module.

if(ZEPHLET_TYPELAB)

module = ZEPHLET_TYPELAB
module-str = zlet_typelab
source "subsys/logging/Kconfig.template.log_config"

endif
```

## src/typelab/tests/integration/testcase.yaml
```yaml
tests:
  typelab.integration:
    tags: integration zephlet typelab
    harness: ztest
    platform_allow:
      - native_sim
      - native_sim/native/64 # arm64 hosts (Apple Silicon) need this qualifier
      - mps2/an385 # A qemu alternative for macos and windows
    timeout: 60
```
