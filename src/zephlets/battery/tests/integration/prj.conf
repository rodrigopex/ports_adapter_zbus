## CMakeLists.txt
```
cmake_minimum_required(VERSION 3.20.0)

# Get absolute path to project root (go up 5 levels from tests/integration)
get_filename_component(PROJECT_ROOT "${CMAKE_CURRENT_SOURCE_DIR}/../../../../.." ABSOLUTE)
set(ZEPHLETS_ROOT "${PROJECT_ROOT}/src/zephlets")

# Initialize global property for proto files (modules will append to this)
set_property(GLOBAL PROPERTY PROTO_FILES_LIST)

# Set up external modules - they register their proto files
# shared_zephlet is loaded via west.yml, so only add application zephlets
list(APPEND EXTRA_ZEPHYR_MODULES
    "${ZEPHLETS_ROOT}/battery"
)

# Find Zephyr - this loads external modules which register proto files
find_package(Zephyr REQUIRED HINTS $ENV{ZEPHYR_BASE})

project(test_battery_integration)

# Process proto files that were registered by modules
list(APPEND CMAKE_MODULE_PATH ${ZEPHYR_BASE}/modules/nanopb)
include(nanopb)
set(NANOPB_OPTIONS "--c-style")
get_property(LOCAL_PROTO_FILES_LIST GLOBAL PROPERTY PROTO_FILES_LIST)

# IMPORTANT: Override CMAKE_CURRENT_SOURCE_DIR temporarily so nanopb generates
# files with correct directory structure (battery/*.pb.h)
set(SAVED_CMAKE_CURRENT_SOURCE_DIR ${CMAKE_CURRENT_SOURCE_DIR})
set(CMAKE_CURRENT_SOURCE_DIR "${PROJECT_ROOT}/src/zephlets")
zephyr_nanopb_sources(app ${LOCAL_PROTO_FILES_LIST})
set(CMAKE_CURRENT_SOURCE_DIR ${SAVED_CMAKE_CURRENT_SOURCE_DIR})

# Test sources
target_sources(app PRIVATE
    src/test_battery_integration.c
)

# Include paths for test helpers
target_include_directories(app PRIVATE
    ${PROJECT_ROOT}/tests/common
    ${ZEPHYR_BASE}/subsys/testsuite/include
)
```

## prj.conf
```kconfig
# Ztest configuration
CONFIG_ZTEST=y
CONFIG_ASSERT=y

# Logging
CONFIG_LOG=y
CONFIG_ZEPHLET_BATTERY_LOG_LEVEL_DBG=y

# Use zbus
CONFIG_ZBUS=y
CONFIG_ZBUS_CHANNEL_NAME=y
CONFIG_ZBUS_MSG_SUBSCRIBER=y
CONFIG_ZBUS_RUNTIME_OBSERVERS=y

# Zephlets infrastructure
CONFIG_ZEPHLETS=y
CONFIG_ZEPHLET_BATTERY=y

# Stack and memory
CONFIG_MAIN_STACK_SIZE=2048
CONFIG_HEAP_MEM_POOL_SIZE=4096
```

## src/test_battery_integration.c
```c
/*
 * Copyright (c) 2025
 * SPDX-License-Identifier: Apache-2.0
 */

#include <zephyr/ztest.h>
#include <zephyr/kernel.h>
#include "zlet_battery_interface.h"

/* Counter for callbacks */
static int report_count = 0;
static struct msg_zlet_battery_report last_report;

K_SEM_DEFINE(report_sem, 0, 10);

/* Real async listener - no mocking! */
static void battery_report_listener(const struct zbus_channel *chan)
{
	const struct msg_zlet_battery_report *msg = zbus_chan_const_msg(chan);

	if (chan == &chan_zlet_battery_report) {
		memcpy(&last_report, msg, sizeof(last_report));
		report_count++;
		k_sem_give(&report_sem);
	}
}

ZBUS_LISTENER_DEFINE(test_lis, battery_report_listener);
ZBUS_CHAN_ADD_OBS(chan_zlet_battery_report, test_lis, 2);

/* Reset between tests */
static void reset(void *fixture)
{
	ARG_UNUSED(fixture);
	report_count = 0;
	memset(&last_report, 0, sizeof(last_report));
	k_sem_reset(&report_sem);
}

ZTEST_SUITE(battery_integration, NULL, NULL, reset, NULL, NULL);

/* Test 1: Start publishes status */
ZTEST(battery_integration, test_start)
{
	zlet_battery_start(K_MSEC(100));

	/* Wait for listener callback */
	zassert_ok(k_sem_take(&report_sem, K_SECONDS(1)), "No status report received");

	zassert_equal(last_report.which_battery_report, MSG_ZLET_BATTERY_REPORT_STATUS_TAG,
		      "Expected status report");
	zassert_true(last_report.status.is_running, "battery should be running");
	zassert_equal(report_count, 1, "Expected 1 report");
}

/* Test 2: Stop stops zephlet */
ZTEST(battery_integration, test_stop)
{
	/* Start zephlet */
	zlet_battery_start(K_MSEC(100));
	zassert_ok(k_sem_take(&report_sem, K_SECONDS(1)), "No start status");

	/* Stop zephlet */
	zlet_battery_stop(K_MSEC(100));
	zassert_ok(k_sem_take(&report_sem, K_SECONDS(1)), "No stop status");
	zassert_equal(last_report.which_battery_report, MSG_ZLET_BATTERY_REPORT_STATUS_TAG,
		      "Expected status report");
	zassert_false(last_report.status.is_running, "battery should be stopped");
}

/* Test 3: Get status returns current state */
ZTEST(battery_integration, test_get_status)
{
	/* Start zephlet first */
	zlet_battery_start(K_MSEC(100));
	zassert_ok(k_sem_take(&report_sem, K_SECONDS(1)), "No start status");

	/* Reset counter */
	report_count = 0;

	/* Get status */
	zlet_battery_get_status(K_MSEC(100));
	zassert_ok(k_sem_take(&report_sem, K_SECONDS(1)), "No status from get");
	zassert_equal(last_report.which_battery_report, MSG_ZLET_BATTERY_REPORT_STATUS_TAG,
		      "Expected status report");
	zassert_true(last_report.status.is_running, "Should be running");
}

/** Test 4: Config set publishes config */
ZTEST(battery_integration, test_config_set)
{
	zlet_battery_config_set(3700, 20, K_MSEC(100));

	zassert_ok(k_sem_take(&report_sem, K_SECONDS(1)), "No config report received");
	zassert_equal(last_report.which_battery_report, MSG_ZLET_BATTERY_REPORT_CONFIG_TAG,
		      "Expected config report");
	zassert_equal(last_report.config.voltage_operation, 3700, "Voltage mismatch");
	zassert_equal(last_report.config.low_battery_threshold, 20, "Threshold mismatch");
}

/** Test 5: Get config returns current config */
ZTEST(battery_integration, test_config_get)
{
	/** First set config */
	zlet_battery_config_set(3600, 15, K_MSEC(100));
	zassert_ok(k_sem_take(&report_sem, K_SECONDS(1)), "No config report");

	/** Reset counter */
	report_count = 0;

	/** Get config */
	zlet_battery_get_config(K_MSEC(100));
	zassert_ok(k_sem_take(&report_sem, K_SECONDS(1)), "No config report from get");
	zassert_equal(last_report.which_battery_report, MSG_ZLET_BATTERY_REPORT_CONFIG_TAG,
		      "Expected config report");
	zassert_equal(last_report.config.voltage_operation, 3600, "Voltage mismatch");
	zassert_equal(last_report.config.low_battery_threshold, 15, "Threshold mismatch");
}

/* Test 6: Start-Stop-Start cycle works */
ZTEST(battery_integration, test_lifecycle_cycle)
{
	/* Start */
	zlet_battery_start(K_MSEC(100));
	zassert_ok(k_sem_take(&report_sem, K_SECONDS(1)), "No start status");
	zassert_true(last_report.status.is_running, "Should be running");

	/* Stop */
	zlet_battery_stop(K_MSEC(100));
	zassert_ok(k_sem_take(&report_sem, K_SECONDS(1)), "No stop status");
	zassert_false(last_report.status.is_running, "Should be stopped");

	/* Start again */
	zlet_battery_start(K_MSEC(100));
	zassert_ok(k_sem_take(&report_sem, K_SECONDS(1)), "No restart status");
	zassert_true(last_report.status.is_running, "Should be running again");
}

/** Test 7: Custom RPC tests */
ZTEST(battery_integration, test_get_battery_state)
{
	/* Start zephlet */
	zlet_battery_start(K_MSEC(100));
	zassert_ok(k_sem_take(&report_sem, K_SECONDS(1)), "No start status");

	/* Get battery state */
	zlet_battery_get_battery_state(K_MSEC(100));

	/* Wait for battery_state report */
	zassert_ok(k_sem_take(&report_sem, K_SECONDS(1)), "No battery_state report");
	zassert_equal(last_report.which_battery_report, MSG_ZLET_BATTERY_REPORT_BATTERY_STATE_TAG,
		      "Expected battery_state report");

	/* Verify state */
	zassert_equal(last_report.battery_state.voltage, 3300, "Initial voltage should be 3300mV");
	zassert_equal(last_report.battery_state.temperature, 25, "Temperature should be 25C");
	zassert_false(last_report.battery_state.is_charging, "Should not be charging");

	/* Stop */
	zlet_battery_stop(K_MSEC(100));
	zassert_ok(k_sem_take(&report_sem, K_SECONDS(1)), "No stop status");
}

ZTEST(battery_integration, test_low_battery_event)
{
	/* Start with low threshold */
	zlet_battery_start(K_MSEC(100));
	zassert_ok(k_sem_take(&report_sem, K_SECONDS(1)), "No start status");

	zlet_battery_config_set(3300, 3100, K_MSEC(100));
	zassert_ok(k_sem_take(&report_sem, K_SECONDS(1)), "No config report");

	/* Wait for low battery event (voltage decays 10mV/sec, starts at 3300, triggers at <3100) */
	/* Should trigger after 20+ ticks */
	zassert_ok(k_sem_take(&report_sem, K_SECONDS(25)), "No low battery event");
	zassert_equal(last_report.which_battery_report, MSG_ZLET_BATTERY_REPORT_EVENTS_TAG,
		      "Expected events report");

	zassert_true(last_report.events.has_low_battery, "Should have low_battery event");
	zassert_true(last_report.events.low_battery, "Low battery flag should be true");

	/* Stop */
	zlet_battery_stop(K_MSEC(100));
	zassert_ok(k_sem_take(&report_sem, K_SECONDS(1)), "No stop status");
}
```
