## zephlets/tick/Kconfig
```kconfig
config TICK_ZEPHLET
    bool "Tick Zephlet Module"
    select NANOPB
    select ZBUS
    select ZBUS_ASYNC_LISTENER
    help
      Enable this option to include the tick zephlet module which provides periodic tick functionality.

if(TICK_ZEPHLET)

module = TICK_ZEPHLET
module-str = tick_zephlet
source "subsys/logging/Kconfig.template.log_config"

endif
```

## zephlets/tick/tests/integration/testcase.yaml
```yaml
tests:
  tick.integration:
    tags: integration zephlet tick
    harness: ztest
    platform_allow:
      - native_sim
      - qemu_cortex_m3
    timeout: 60
```

## zephlets/ui/Kconfig
```kconfig
config UI_ZEPHLET
    bool "UI Zephlet Module"
    select NANOPB
    select ZBUS
    select ZBUS_ASYNC_LISTENER
    help
      Enable this option to include the UI Zephlet Module in the build.
      This module provides user interface functionalities for the application.

if(UI_ZEPHLET)

module = UI_ZEPHLET
module-str = ui_zephlet
source "subsys/logging/Kconfig.template.log_config"

endif
```
