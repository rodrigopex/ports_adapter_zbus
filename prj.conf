## CMakeLists.txt
```
# SPDX-License-Identifier: Apache-2.0

cmake_minimum_required(VERSION 3.20.0)

# Global property holding the list of proto files contributed by each
# zephlet module (registered in their own CMakeLists.txt).
set_property(GLOBAL PROPERTY PROTO_FILES_LIST)

# Zephlets live directly under src/. The framework imposes no layout;
# this app's choice is a flat src/<name>/ per zephlet.
set(EXTRA_ZEPHYR_MODULES
    "${CMAKE_SOURCE_DIR}/src/ui"
    "${CMAKE_SOURCE_DIR}/src/tick"
    "${CMAKE_SOURCE_DIR}/src/tampering"
    "${CMAKE_SOURCE_DIR}/src/typelab"
)

find_package(Zephyr REQUIRED HINTS $ENV{ZEPHYR_BASE})
project(ports_adapters_zbus)

list(APPEND CMAKE_MODULE_PATH ${ZEPHYR_BASE}/modules/nanopb)
include(nanopb)

set(NANOPB_OPTIONS "--c-style")

get_property(LOCAL_PROTO_FILES_LIST GLOBAL PROPERTY PROTO_FILES_LIST)

# Anchor nanopb output at src/ so each proto lands at
# ${CMAKE_BINARY_DIR}/<zephlet>/<prefix>.pb.h — matching the
# `#include "<type>/<prefix>.pb.h"` pattern the generator emits.
set(SAVED_CMAKE_CURRENT_SOURCE_DIR ${CMAKE_CURRENT_SOURCE_DIR})
set(CMAKE_CURRENT_SOURCE_DIR "${CMAKE_SOURCE_DIR}/src")
zephyr_nanopb_sources(app ${LOCAL_PROTO_FILES_LIST})
set(CMAKE_CURRENT_SOURCE_DIR ${SAVED_CMAKE_CURRENT_SOURCE_DIR})

target_sources(app PRIVATE src/main.c src/policies.c)
```

## west.yml
```
manifest:
        remotes:
                - name: zephyrproject-rtos
                  url-base: https://github.com/zephyrproject-rtos

        projects:
                - name: zbook
                  url: https://github.com/zephyr-book/zbook
                  revision: main
                - name: zephlet
                  url: git@github.com:rodrigopex/zephlet.git
                  path: modules/lib/zephlet
                  revision: main
                  west-commands: west/west-commands.yml
                - name: zview
                  url: https://github.com/wkhadgar/zview
                  revision: v0.13.0
                  path: modules/tools/zview
                  west-commands: scripts/west-commands.yml
                - name: zephyr-nanopb-textformat
                  url: https://github.com/rodrigopex/zephyr-nanopb-textformat
                  revision: v0.8.1
                  path: modules/lib/zephyr-nanopb-textformat
                - name: zephyr
                  remote: zephyrproject-rtos
                  revision: v4.4.2
                  clone-depth: 1
                  import:
                          # By using name-allowlist we clone only required modules
                          name-allowlist:
                                  - cmsis_6 # ARM CMSIS (required by soc/arm/mps2/soc.h)
                                  - nanopb # Protobuf codegen (zephlet requirement)
                                  - hal_nordic # Nordic HAL (required for nrf52833dk builds)
                                  - hal_rpi_pico
                                  - fatfs
                                  - littlefs
                                  - mbedtls # mbedTLS (CONFIG_ZEPHLETS_COAP_DTLS, PSK)
                                  - tf-psa-crypto # mbedTLS 4.x PSA crypto backend (DTLS dep)
```

## prj.conf
```kconfig
CONFIG_ZEPHLETS=y
CONFIG_ZEPHLET_TICK=y
CONFIG_ZEPHLET_UI=y
CONFIG_ZEPHLET_TAMPERING=y
CONFIG_ZEPHLET_TYPELAB=y

# `zlet typelab_bench config ...` / `get_config` — exercises every
# nanopb scalar type the shell frontend supports.
CONFIG_ZEPHLETS_SHELL=y
# The three settings below are application choices, not library
# requirements -- the library never sees the shell. Its
# docs/shell-integration.md explains each one; the sizes here are for
# typelab's 18-field message and are not a default anyone should copy.
# CONFIG_SHELL_WILDCARD needs no attention: a zephlet RPC's raw argument
# is never tokenised, so wildcard expansion cannot reach it (see the
# infra's ADR-0001 addendum).
#
# typelab_config carries uint64/int64/fixed64/sfixed64, and only fields
# wider than 32 bits need this -- since v0.3.0 the printer uses
# width-correct conversions rather than promoting everything to long long.
# A genuine 64-bit field reports PB_TF_ERR_UNSUPPORTED without it, instead
# of printing a wrong number.
CONFIG_CBPRINTF_FULL_INTEGRAL=y
# Caps the whole command line, not just the message. Text format names
# every field it sets, so it is more verbose than the positional form it
# replaced: one line carrying all 18 typelab fields runs to roughly 460
# characters, past the 256-byte default.
CONFIG_SHELL_CMD_BUFF_SIZE=1024
# A *pasted* (or piped) message arrives faster than the shell drains it,
# and the serial RX ring buffer defaults to 64 bytes -- a long line is
# silently truncated mid-parse. Typing is slow enough not to notice.
CONFIG_SHELL_BACKEND_SERIAL_RX_RING_BUFFER_SIZE=1024

CONFIG_LOG=y
CONFIG_ZEPHLET_TICK_LOG_LEVEL_DBG=y
CONFIG_ZEPHLET_UI_LOG_LEVEL_DBG=y
CONFIG_ZEPHLET_TAMPERING_LOG_LEVEL_DBG=y
CONFIG_ZEPHLET_TYPELAB_LOG_LEVEL_DBG=y

CONFIG_ASSERT=y

CONFIG_SENSOR=y
CONFIG_SHELL=y

CONFIG_PWM=y
CONFIG_PWM_RPI_PICO=y

CONFIG_ASSERT=y

CONFIG_HEAP_MEM_POOL_SIZE=32768

CONFIG_GPIO_SHELL=y

CONFIG_MAIN_STACK_SIZE=5200
CONFIG_SHELL_STACK_SIZE=5200

# CONFIG_FLASH=y
# CONFIG_FLASH_MAP=y
# CONFIG_FILE_SYSTEM=y
# CONFIG_FILE_SYSTEM_LITTLEFS=y
```

## prj_coap.conf
```kconfig
CONFIG_ZEPHLETS_COAP=y

# Native simulator networking. Offloaded sockets forward Zephyr socket calls
# to the host BSD stack so the CoAP server binds a real host socket on
# 0.0.0.0:5683 — reachable from anything routed to the container's network.
CONFIG_NET_DRIVERS=y
CONFIG_NET_SOCKETS=y
CONFIG_NET_SOCKETS_OFFLOAD=y
CONFIG_NET_NATIVE_OFFLOADED_SOCKETS=y
CONFIG_NET_IPV6_DAD=n

CONFIG_COAP=y
CONFIG_COAP_SERVER=y
CONFIG_COAP_URI_WILDCARD=y

CONFIG_MAIN_STACK_SIZE=2048
```

## prj_zbook_coap.conf
```kconfig
CONFIG_ZEPHLETS_COAP=y
CONFIG_COAP_SERVER_WELL_KNOWN_CORE=y

CONFIG_COAP=y
CONFIG_COAP_SERVER=y
CONFIG_COAP_URI_WILDCARD=y
CONFIG_NET_DRIVERS=y
CONFIG_NET_SOCKETS=y
CONFIG_NET_SOCKETS_OFFLOAD=y
CONFIG_COAP_SERVER_SHELL=y

# The CoAP server poll loop creates an eventfd as its control socket, and the
# DNS socket-service needs one too; the default cap of 1 starves them (ENOMEM).
CONFIG_ZVFS_EVENTFD_MAX=4

CONFIG_MAIN_STACK_SIZE=2048
```

## prj_zview.conf
```kconfig
CONFIG_INIT_STACKS=y            # Required for stack watermarks
CONFIG_THREAD_MONITOR=y         # Required for thread discovery
CONFIG_THREAD_STACK_INFO=y      # Required for thread metadata

# Optional Features
CONFIG_THREAD_NAME=y            # Enables thread name display
CONFIG_THREAD_RUNTIME_STATS=y   # Enables CPU usage tracking
CONFIG_SYS_HEAP_RUNTIME_STATS=y # Enables heap runtime stats and fragmentation map
```

## src/main.c
```c
/*
 * Copyright (c) 2012-2014 Wind River Systems, Inc.
 *
 * SPDX-License-Identifier: Apache-2.0
 */

#include <errno.h>

#include <zephyr/kernel.h>
#include <zephyr/logging/log.h>

#include <nanopb_textformat.h>

#include "zephlet_textformat.h"
#include "zlet_tick.h"
#include "zlet_ui.h"
#include "zlet_tampering.h"
#include "zlet_typelab.h"

LOG_MODULE_REGISTER(main, LOG_LEVEL_DBG);

/* ----- Printing proto structs ------------------------------------------
 *
 * Rather than hand-writing a format string per message -- which has to be
 * kept in step with the .proto by hand, and quietly goes stale when a
 * field is added -- print the struct as protobuf text format. The
 * descriptors come from codegen (`PB_TF_DEFINE` per message in
 * `<prefix>_interface.c`, declared in its header); `lifecycle_status_t_tf`
 * is the shared zephlet.proto one, from `zephlet_textformat.h`.
 *
 * Style is named at the call site. `pb_tf_print_buf_compact_braces()` puts
 * a message on one line wrapped in `{...}`, which reads better in a log
 * than bare fields do -- the braces show where one message ends and the
 * next label begins. Note the trade: outer braces are an input extension
 * this library accepts but `protoc` does not, so a braced line is not
 * portable text format. That is fine for a log; use the plain
 * `_compact` form for anything meant to be fed back through standard
 * tooling. The shell frontend does exactly that.
 *
 * The `_buf` form is preferred over `pb_tf_print()` with a character sink:
 * it terminates the buffer even when a message prints nothing, and reports
 * truncation as PB_TF_ERR_NO_SPACE rather than a flag to remember to
 * check.
 */
static void print_proto(const char *label, const struct pb_tf_msg *tf, const void *msg)
{
	/* Static, not a local: main's stack is generous but the library's own
	 * guidance is to keep the output buffer off it. Only ever called from
	 * this thread, sequentially. */
	static char text[192];
	int err = pb_tf_print_buf_compact_braces(tf, msg, text, sizeof(text));

	if (err != 0) {
		printk("%s: cannot print: %s\n", label, pb_tf_strerror(err));
		return;
	}

	/* Compact carries no terminator of its own, so the label and the
	 * braced message share a line and this adds the newline. */
	printk("%s: %s\n", label, text);
}

/* ----- Instance storage + initial config ------------------------------ */

static struct tick_config tick_cfg = {
	.duration_ms = 600,
	.period_ms = 1000,
};
static struct tick_data tick_data_storage;
ZEPHLET_NEW(tick, tick_timer_based_impl, &tick_cfg, &tick_data_storage, tick_init_fn);

static struct ui_config ui_cfg = {
	.user_button_long_press_duration = 1000,
};
static struct ui_data ui_data_storage;
ZEPHLET_NEW(ui, ui_fake_impl, &ui_cfg, &ui_data_storage, ui_init_fn);

static struct tampering_config tampering_cfg = {
	.light_tamper_threshold = 100,
	.proximity_tamper_threshold = 50,
};
static struct tampering_data tampering_data_storage;
ZEPHLET_NEW(tampering, tampering_emul_impl, &tampering_cfg, &tampering_data_storage,
	    tampering_init_fn);

/* Bench for exercising every shell-supported nanopb scalar type via
 * `zlet typelab_bench config ...` / `get_config` — see
 * src/typelab/zlet_typelab.proto. No policies wiring: it's a standalone
 * type-exercise fixture, not part of the tick/ui/tampering event chain. */
static struct typelab_config typelab_cfg;
static struct typelab_data typelab_data_storage;
ZEPHLET_NEW(typelab, typelab_bench, &typelab_cfg, &typelab_data_storage, typelab_init_fn);

int main(void)
{
	printk("Example project running on a %s board.\n", CONFIG_BOARD_TARGET);

	if (!tick_is_ready(&tick_timer_based_impl)) {
		LOG_ERR("Tick not ready");
		return -ENODEV;
	}
	if (!ui_is_ready(&ui_fake_impl)) {
		LOG_ERR("UI not ready");
		return -ENODEV;
	}
	if (!tampering_is_ready(&tampering_emul_impl)) {
		LOG_ERR("Tampering not ready");
		return -ENODEV;
	}

	struct tick_config tick_config_now = {0};
	if (tick_get_config(&tick_timer_based_impl, &tick_config_now, K_MSEC(500)) == 0) {
		print_proto("Tick config", &tick_config_t_tf, &tick_config_now);
	}

	struct tick_config tick_new = {.duration_ms = 3000, .period_ms = 1000};
	if (tick_config(&tick_timer_based_impl, &tick_new, NULL, K_MSEC(500)) == 0) {
		print_proto("Tick config updated", &tick_config_t_tf, &tick_new);
	}

	struct lifecycle_status st = {0};

	if (ui_start(&ui_fake_impl, &st, K_MSEC(500)) == 0) {
		print_proto("UI status", &lifecycle_status_t_tf, &st);
	}

	if (tick_alt_start(&tick_timer_based_impl, &st, K_MSEC(500)) == 0) {
		print_proto("Tick status", &lifecycle_status_t_tf, &st);
	}

	k_sleep(K_SECONDS(10));

	(void)tick_alt_stop(&tick_timer_based_impl, NULL, K_MSEC(500));

	(void)tampering_start(&tampering_emul_impl, NULL, K_FOREVER);
	(void)tampering_force_tampering(&tampering_emul_impl, K_MSEC(250));
	(void)tampering_stop(&tampering_emul_impl, NULL, K_FOREVER);

	(void)ui_stop(&ui_fake_impl, NULL, K_MSEC(500));
	return 0;
}
```

## src/adapters.c
```c
/*
 * Copyright (c) 2025
 * SPDX-License-Identifier: Apache-2.0
 *
 * App-local adapters, composed from the framework's
 * ZEPHLET_EVENTS_LISTENER primitive. Both adapters forward to the UI
 * instance's blink RPC.
 */

#include <zephyr/kernel.h>
#include <zephyr/logging/log.h>

#include "zephlet.h"
#include "zlet_tick.h"
#include "zlet_ui.h"
#include "zlet_tampering.h"

LOG_MODULE_REGISTER(adapters, LOG_LEVEL_DBG);

/* Instances are defined (via ZEPHLET_DEFINE) in main.c. */
extern const struct zephlet z_ui;

static void on_tick_event(const struct tick_events *ev)
{
	LOG_DBG("tick event @%d -> ui_blink", ev->timestamp);
	(void)ui_blink(&z_ui, K_MSEC(100));
}
ZEPHLET_EVENTS_LISTENER(tick_base, tick, on_tick_event);

static void on_tampering_event(const struct tampering_events *ev)
{
	if (ev->proximity_tamper_detected) {
		LOG_DBG("tampering proximity @%d -> ui_blink", ev->timestamp);
		(void)ui_blink(&z_ui, K_MSEC(100));
	}
}
ZEPHLET_EVENTS_LISTENER(tampering_service, tampering, on_tampering_event);
```

## src/policies.c
```c
/*
 * Copyright (c) 2025
 * SPDX-License-Identifier: Apache-2.0
 *
 * App-local policies, composed from the framework's
 * ZEPHLET_EVENTS_LISTENER primitive. Both policies forward to the UI
 * instance's blink RPC.
 */

#include <zephyr/kernel.h>
#include <zephyr/logging/log.h>

#include "zephlet.h"
#include "zlet_tick.h"
#include "zlet_ui.h"
#include "zlet_tampering.h"

LOG_MODULE_REGISTER(policies, LOG_LEVEL_DBG);

/* Instances are defined (via ZEPHLET_NEW) in main.c. */
extern const struct zephlet ui_fake_impl;

#if defined(CONFIG_ZEPHLET_TICK) && defined(CONFIG_ZEPHLET_UI)
static void on_tick_event(const struct zephlet *z, const struct tick_events *ev)
{
	LOG_DBG("from %s: tick event @%d -> ui_blink", z->name, ev->timestamp);
	(void)ui_blink(&ui_fake_impl, K_MSEC(100));
}
ZEPHLET_EVENTS_LISTENER(tick_timer_based_impl, tick, on_tick_event);
#endif

#if defined(CONFIG_ZEPHLET_TAMPERING) && defined(CONFIG_ZEPHLET_UI)
static void on_tampering_event(const struct zephlet *z, const struct tampering_events *ev)
{
	if (ev->proximity_tamper_detected) {
		LOG_DBG("tampering proximity @%d -> ui_blink", ev->timestamp);
		(void)ui_blink(&ui_fake_impl, K_MSEC(100));
	}
}
ZEPHLET_EVENTS_LISTENER(tampering_emul_impl, tampering, on_tampering_event);
#endif
```
