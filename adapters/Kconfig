## adapters/Kconfig
```kconfig
config ADAPTERS
    bool "Zephlet adapters"
    default y
    select ZBUS
    select ZBUS_ASYNC_LISTENER
    help
      tbd

if(ADAPTERS)

config TICK_TO_UI_ADAPTER
    bool "From tick to ui zephlet adapter"
    default y
    depends on ZEPHLET_TICK && ZEPHLET_UI

config DEBUG_ADAPTER
    bool "From any to main zephlet adapter"
    default y
    depends on ZEPHLET_TICK && ZEPHLET_TAMPER_DETECTION

config BATTERY_TO_STORAGE_ADAPTER
	bool "From battery to storage zephlet adapter"
	default y
	depends on ZEPHLET_BATTERY && ZEPHLET_STORAGE

config TICK_TO_STORAGE_ADAPTER
	bool "From tick to storage zephlet adapter"
	default y
	depends on ZEPHLET_TICK && ZEPHLET_STORAGE

config POSITION_TO_BATTERY_ADAPTER
	bool "From position to battery zephlet adapter"
	default y
	depends on ZEPHLET_POSITION && ZEPHLET_BATTERY

module = ADAPTERS
module-str = adapter
source "subsys/logging/Kconfig.template.log_config"

endif
```

## modules/services/storage/Kconfig
```kconfig
config STORAGE_SERVICE
    bool "Storage Service Module"
    select NANOPB
    select ZBUS
    select ZBUS_ASYNC_LISTENER
    help
      Enable this option to include the Storage Service Module in the build.
      Storage Service Module.

if(STORAGE_SERVICE)

module = STORAGE_SERVICE
module-str = storage_service
source "subsys/logging/Kconfig.template.log_config"

endif
```

## modules/services/tamper_detection/Kconfig
```kconfig
config TAMPER_DETECTION_SERVICE
    bool "Tamper Detection Service Module"
    select NANOPB
    select ZBUS
    select ZBUS_ASYNC_LISTENER
    help
      Enable this option to include the Tamper Detection Service Module in the build.
      Tamper Detection Service Module.

if(TAMPER_DETECTION_SERVICE)

module = TAMPER_DETECTION_SERVICE
module-str = tamper_detection_service
source "subsys/logging/Kconfig.template.log_config"

endif
```

## modules/services/ui/Kconfig
```kconfig
config UI_SERVICE
    bool "UI Service Module"
    select NANOPB
    select ZBUS
    select ZBUS_ASYNC_LISTENER
    help
      Enable this option to include the UI Service Module in the build.
      This module provides user interface functionalities for the application.

if(UI_SERVICE)

module = UI_SERVICE
module-str = ui_service
source "subsys/logging/Kconfig.template.log_config"

endif
```

## services/battery/Kconfig
```kconfig
config BATTERY_SERVICE
    bool "Battery Service Module"
    select NANOPB
    select ZBUS
    select ZBUS_ASYNC_LISTENER
    help
      Enable this option to include the Battery Service Module in the build.
      Battery Service Module.

if(BATTERY_SERVICE)

module = BATTERY_SERVICE
module-str = battery_service
source "subsys/logging/Kconfig.template.log_config"

endif
```

## services/shared/codegen/zephyr_service_template/template/{{ service_name_lower }}/Kconfig.jinja
```kconfig
config {{ service_name_upper }}_SERVICE
    bool "{{ service_name }} Service Module"
    select NANOPB
    select ZBUS
    select ZBUS_ASYNC_LISTENER
    help
      Enable this option to include the {{ service_name }} Service Module in the build.
      {{ service_description }}.

if({{ service_name_upper }}_SERVICE)

module = {{ service_name_upper }}_SERVICE
module-str = {{ service_name_lower }}_service
source "subsys/logging/Kconfig.template.log_config"

endif
```

## services/tick/Kconfig
```kconfig
config TICK_SERVICE
    bool "Tick Service Module"
    select NANOPB
    select ZBUS
    select ZBUS_ASYNC_LISTENER
    help
      Enable this option to include the tick service module which provides periodic tick functionality.

if(TICK_SERVICE)

module = TICK_SERVICE
module-str = tick_service
source "subsys/logging/Kconfig.template.log_config"

endif
```

## src/adapters/Kconfig
```kconfig
config ADAPTERS
    bool "Zephlet adapters"
    default y
    select ZBUS
    select ZBUS_ASYNC_LISTENER
    help
      tbd

if(ADAPTERS)

config TICK_TO_UI_ADAPTER
    bool "From tick to ui zephlet adapter"
    default y
    depends on ZEPHLET_TICK && ZEPHLET_UI

config DEBUG_ADAPTER
    bool "From any to main zephlet adapter"
    default y
    depends on ZEPHLET_TICK && ZEPHLET_TAMPER_DETECTION

config TAMPERING_TO_UI_ADAPTER
	bool "From tampering to ui zephlet adapter"
	default y
	depends on ZEPHLET_TAMPERING && ZEPHLET_UI

module = ADAPTERS
module-str = adapter
source "subsys/logging/Kconfig.template.log_config"

endif
```

## src/tampering/Kconfig
```kconfig
config ZEPHLET_TAMPERING
    bool "Tampering Zephlet Module"
    select NANOPB
    select ZBUS
    select ZBUS_ASYNC_LISTENER
    help
      Enable this option to include the Tampering Zephlet Module in the build.
      Tampering Zephlet Module.

if(ZEPHLET_TAMPERING)

module = ZEPHLET_TAMPERING
module-str = zlet_tampering
source "subsys/logging/Kconfig.template.log_config"

endif
```

## src/tampering/tests/integration/testcase.yaml
```yaml
tests:
  tampering.integration:
    tags: integration zephlet tampering
    harness: ztest
    platform_allow:
      - native_sim
      - mps2/an385 # A qemu alternative for macos and windows
    timeout: 60
```

## src/tick/Kconfig
```kconfig
config ZEPHLET_TICK
    bool "Tick Zephlet Module"
    select NANOPB
    select ZBUS
    select ZBUS_ASYNC_LISTENER
    help
      Enable this option to include the tick zephlet module which provides periodic tick functionality.

if(ZEPHLET_TICK)

module = ZEPHLET_TICK
module-str = zlet_tick
source "subsys/logging/Kconfig.template.log_config"

endif
```

## src/tick/tests/integration/testcase.yaml
```yaml
tests:
  tick.integration:
    tags: integration zephlet tick
    harness: ztest
    platform_allow:
      - native_sim
      - mps2/an385 # A qemu alternative for macos and windows
    timeout: 60
```

## src/ui/Kconfig
```kconfig
config ZEPHLET_UI
    bool "UI Zephlet Module"
    select NANOPB
    select ZBUS
    select ZBUS_ASYNC_LISTENER
    help
      Enable this option to include the UI Zephlet Module in the build.
      This module provides user interface functionalities for the application.

if(ZEPHLET_UI)

module = ZEPHLET_UI
module-str = zlet_ui
source "subsys/logging/Kconfig.template.log_config"

endif
```

## src/zephlets/battery/tests/integration/testcase.yaml
```yaml
tests:
  battery.integration:
    tags: integration zephlet battery
    harness: ztest
    platform_allow:
      - native_sim
      - mps2/an385 # A qemu alternative for macos and windows
    timeout: 60
```

## src/zephlets/position/Kconfig
```kconfig
config ZEPHLET_POSITION
    bool "Position Zephlet Module"
    select NANOPB
    select ZBUS
    select ZBUS_ASYNC_LISTENER
    help
      Enable this option to include the Position Zephlet Module in the build.
      Position Zephlet Module.

if(ZEPHLET_POSITION)

module = ZEPHLET_POSITION
module-str = zlet_position
source "subsys/logging/Kconfig.template.log_config"

endif
```

## src/zephlets/position/tests/integration/testcase.yaml
```yaml
tests:
  position.integration:
    tags: integration zephlet position
    harness: ztest
    platform_allow:
      - native_sim
      - mps2/an385 # A qemu alternative for macos and windows
    timeout: 60
```

## src/zephlets/storage/Kconfig
```kconfig
config ZEPHLET_STORAGE
    bool "Storage Zephlet Module"
    select NANOPB
    select ZBUS
    select ZBUS_ASYNC_LISTENER
    help
      Enable this option to include the Storage Zephlet Module in the build.
      Storage Zephlet Module.

if(ZEPHLET_STORAGE)

module = ZEPHLET_STORAGE
module-str = zlet_storage
source "subsys/logging/Kconfig.template.log_config"

endif
```

## src/zephlets/storage/tests/integration/testcase.yaml
```yaml
tests:
  storage.integration:
    tags: integration zephlet storage
    harness: ztest
    platform_allow:
      - native_sim
      - mps2/an385 # A qemu alternative for macos and windows
    timeout: 60
```

## src/zephlets/tick/tests/integration/testcase.yaml
```yaml
tests:
  tick.integration:
    tags: integration zephlet tick
    harness: ztest
    platform_allow:
      - native_sim
      - mps2/an385
    timeout: 60
```

## zephlets/battery/Kconfig
```kconfig
config ZEPHLET_BATTERY
    bool "Battery Zephlet Module"
    select NANOPB
    select ZBUS
    select ZBUS_ASYNC_LISTENER
    help
      Enable this option to include the Battery Zephlet Module in the build.
      Battery Zephlet Module.

if(ZEPHLET_BATTERY)

module = ZEPHLET_BATTERY
module-str = zlet_battery
source "subsys/logging/Kconfig.template.log_config"

endif
```

## zephlets/position/Kconfig
```kconfig
config POSITION_ZEPHLET
    bool "Position Zephlet Module"
    select NANOPB
    select ZBUS
    select ZBUS_ASYNC_LISTENER
    help
      Enable this option to include the Position Zephlet Module in the build.
      Position Zephlet Module.

if(POSITION_ZEPHLET)

module = POSITION_ZEPHLET
module-str = position_zephlet
source "subsys/logging/Kconfig.template.log_config"

endif
```

## zephlets/sensor/Kconfig
```kconfig
config ZEPHLET_SENSOR
    bool "Sensor Zephlet Module"
    select NANOPB
    select ZBUS
    select ZBUS_ASYNC_LISTENER
    help
      Enable this option to include the Sensor Zephlet Module in the build.
      This module provides sensor reading functionalities for the application.

if(ZEPHLET_SENSOR)

module = ZEPHLET_SENSOR
module-str = zlet_sensor
source "subsys/logging/Kconfig.template.log_config"

endif
```

## zephlets/shared/codegen/zephyr_zephlet_template/template/{{ zephlet_name_lower }}/Kconfig.jinja
```kconfig
config {{ zephlet_name_upper }}_ZEPHLET
    bool "{{ zephlet_name }} Zephlet Module"
    select NANOPB
    select ZBUS
    select ZBUS_ASYNC_LISTENER
    help
      Enable this option to include the {{ zephlet_name }} Zephlet Module in the build.
      {{ zephlet_description }}.

if({{ zephlet_name_upper }}_ZEPHLET)

module = {{ zephlet_name_upper }}_ZEPHLET
module-str = {{ zephlet_name_lower }}_zephlet
source "subsys/logging/Kconfig.template.log_config"

endif
```

## zephlets/storage/Kconfig
```kconfig
config STORAGE_ZEPHLET
    bool "Storage Zephlet Module"
    select NANOPB
    select ZBUS
    select ZBUS_ASYNC_LISTENER
    help
      Enable this option to include the Storage Zephlet Module in the build.
      Storage Zephlet Module.

if(STORAGE_ZEPHLET)

module = STORAGE_ZEPHLET
module-str = storage_zephlet
source "subsys/logging/Kconfig.template.log_config"

endif
```
